/////////////////////////////////////////////////////////////////////////
//                            Sensor network
//
// Ref
//  http://www.learningaboutelectronics.com/Articles/Arduino-liquid-level-sensor-circuit.php
/////////////////////////////////////////////////////////////////////////


#include "Arduino.h"


//#include <Narcoleptic.h> //low-power sleep


//////////////////////////////////////////////////////////////////////////
// Configuration
//////////////////////////////////////////////////////////////////////////

const uint8_t DEBUG=1; // Debug sends serial-port output


// alarm


// Pin Assignment
const uint8_t flasher_pin= 3; //sensor pin connected to analog pin A0




////////////////////////////////////////////////////////////////////////
// Variables
////////////////////////////////////////////////////////////////////////
uint8_t count;





////////////////////////////////////////////////////////////////////////
////////////////////////////////////////////////////////////////////////
//// Functions
////////////////////////////////////////////////////////////////////////
////////////////////////////////////////////////////////////////////////

void flasher(void){
  if(DEBUG){
    Serial.println("Flashing lights");
  }
  digitalWrite(led_flash, HIGH); // LED on 1
  delay(led_on_time);
  digitalWrite(led_flash, LOW); // LED off
  delay(led_off_time);
  digitalWrite(led_flash, HIGH); // LED on 2
  delay(led_on_time);
  digitalWrite(led_flash, LOW); // LED off

  delay(led_settle_time);

}



////////////////////////////////////////////////////////////////////////
////////////////////////////////////////////////////////////////////////
//// Initial setup
////////////////////////////////////////////////////////////////////////
////////////////////////////////////////////////////////////////////////
void setup(void)
{
  //DEBUG
  if (DEBUG){
    Serial.begin(9600);
    Serial.println("Debug: Startup");
    count = 0;
  }

  // Pin Assignment
  // pinMode(sensorPin, INPUT);//the liquid level sensor will be an input to the arduino
  pinMode(flasher_pin, OUTPUT); //pin for buzzer


}


/////////////////////////////////////////////////////////////////////////
/////////////////////////////////////////////////////////////////////////
//// LOOP forever
/////////////////////////////////////////////////////////////////////////
/////////////////////////////////////////////////////////////////////////
void loop(void){
  // DEBUG
  if (DEBUG){
    Serial.println(".......................");
    Serial.print("Running (loop)... ");
    Serial.println(count);
    count++;
  }

  flasher();

  delay(1000);//delays 100ms
}
