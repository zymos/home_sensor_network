/////////////////////////////////////////////////////////////////////////
//                            Sensor network
//
// Ref
//  http://www.learningaboutelectronics.com/Articles/Arduino-liquid-level-sensor-circuit.php
/////////////////////////////////////////////////////////////////////////


#include "Arduino.h"
#include "Timer.h" // for buzzer

//#include <Narcoleptic.h> //low-power sleep


//////////////////////////////////////////////////////////////////////////
// Configuration
//////////////////////////////////////////////////////////////////////////

const uint8_t DEBUG=1; // Debug sends serial-port output
const uint16_t sleepDelay=1000; //milliseconds

// alarm
const uint16_t beep_durration=2000; //ms
const uint16_t beep_period=3000; //ms
const uint8_t beep_count=10;

// Pin Assignment
const uint8_t water_level_pin= A0; //sensor pin connected to analog pin A0
const uint8_t alarm_pin = 5; //alarm buzzer
const uint8_t buzzer_pin = 10;



////////////////////////////////////////////////////////////////////////
// Variables
////////////////////////////////////////////////////////////////////////
uint8_t count;
uint8_t liquid_level;
uint8_t alarm_status;




////////////////////////////////////////////////////////////////////////
////////////////////////////////////////////////////////////////////////
//// Functions
////////////////////////////////////////////////////////////////////////
////////////////////////////////////////////////////////////////////////

uint8_t alarm(void){ // Activate alarm
  if(liquid_level > 10){
    if (DEBUG){
      Serial.print("Alarm activatied...");
    }
    for(uint8_t i;i<beep_count;i++){
      tone(buzzer_pin,2400,beep_durration);
      delay(beep_period);
    }
    return 1;
  }else{
    return 0;
  }
}

uint8_t detect_water_level(void){ // use water level sensor
  liquid_level = (analogRead(water_level_pin) >> 2); //remove LSB to make 8-bit
  if (DEBUG){
    Serial.print("Liquid level: ");
    Serial.println(liquid_level);//prints out liquid level sensor reading
  }
  return liquid_level;
}




////////////////////////////////////////////////////////////////////////
////////////////////////////////////////////////////////////////////////
//// Initial setup
////////////////////////////////////////////////////////////////////////
////////////////////////////////////////////////////////////////////////
void setup(void)
{
  //DEBUG
  if (DEBUG){
    Serial.begin(9600);
    Serial.println("Debug: Startup");
    count = 0;
  }

  // Pin Assignment
  // pinMode(sensorPin, INPUT);//the liquid level sensor will be an input to the arduino
  pinMode(buzzer_pin, OUTPUT); //pin for buzzer


}


/////////////////////////////////////////////////////////////////////////
/////////////////////////////////////////////////////////////////////////
//// LOOP forever
/////////////////////////////////////////////////////////////////////////
/////////////////////////////////////////////////////////////////////////
void loop(void){
  // DEBUG
  if (DEBUG){
    Serial.println(".......................");
    Serial.print("Running (loop)... ");
    Serial.println(count);
    count++;
  }


  liquid_level = detect_water_level();
  alarm_status = alarm();

  delay(1000);//delays 100ms
}
